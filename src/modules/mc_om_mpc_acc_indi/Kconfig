## src/modules/mc_om_mpc_acc_indi/Kconfig
```kconfig
menuconfig MODULES_MC_OM_MPC_ACC_INDI
	bool "mc_om_mpc_acc_indi"
	default n
	---help---
		Enable the isolated OM-MPC acceleration-INDI middle layer.
```

## src/modules/mc_om_mpc_indi/Kconfig
```kconfig
menuconfig MODULES_MC_OM_MPC_INDI
	bool "mc_om_mpc_indi"
	default n
	---help---
		Enable the isolated OM-MPC acceleration-INDI middle layer.
```

## src/modules/mc_pos_control/Kconfig
```kconfig
menuconfig MODULES_MC_POS_CONTROL
	bool "mc_pos_control"
	default n
	---help---
		Enable support for mc_pos_control

menuconfig USER_MC_POS_CONTROL
	bool "mc_pos_control running as userspace module"
	default y
	depends on BOARD_PROTECTED && MODULES_MC_POS_CONTROL
	---help---
		Put mc_pos_control in userspace memory

config MC_POS_CONTROL_OM_MPC
	bool "Experimental OM-MPC trajectory controller"
	depends on MODULES_MC_POS_CONTROL
	default n
	---help---
		Float32 on-manifold MPC on a private solver work queue, triggered
		by every local-position publication or every second publication.
		Explicit MPC_EN gate, constant phase-rate Orbit/FigureEight only.
```
